## Kconfig
```kconfig
mainmenu "RT-Thread Configuration"

config BSP_DIR
    string
    option env="BSP_ROOT"
    default "."

config RTT_DIR
    string
    option env="RTT_ROOT"
    default "rt-thread"

config PKGS_DIR
    string
    option env="PKGS_ROOT"
    default "packages"

config PLATFORM_DIR
    string
    option env="PLATFORM_DIR"
    default "D:/app/RT-ThreadStudio/workspace/LambdaPi/platform"

source "$RTT_DIR/Kconfig"
source "$PKGS_DIR/Kconfig"
source "$RTT_DIR/../libraries/Kconfig"
source "board/Kconfig"
```
